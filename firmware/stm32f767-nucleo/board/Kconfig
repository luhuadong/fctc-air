## firmware/stm32f767-nucleo/board/Kconfig
```kconfig
menu "Hardware Drivers Config"

config SOC_STM32F767ZI 
    bool
    select SOC_SERIES_STM32F7
    select RT_USING_COMPONENTS_INIT
    select RT_USING_USER_MAIN
    default y

menu "Onboard Peripheral Drivers"

    config BSP_USING_USB_TO_USART 
        bool "Enable USB TO USART (uart3)"
        select BSP_USING_UART3
        default y
        
    config BSP_USING_ETH
        bool "Enable Ethernet"
        select RT_USING_LWIP
        default n

        if BSP_USING_ETH
            choice
                prompt "On-board PHY chip"
                default PHY_USING_LAN8720A

                config PHY_USING_LAN8720A
                    bool "LAN8720A"

                config PHY_USING_DM9161CEP
                    bool "DM9161CEP"

            endchoice
        endif
 
endmenu

menu "On-chip Peripheral Drivers"

    config BSP_USING_GPIO
        bool "Enable GPIO"
        select RT_USING_PIN
        default y

    menuconfig BSP_USING_UART
        bool "Enable UART3"
        default y
        select RT_USING_SERIAL
        if BSP_USING_UART
            config BSP_USING_UART3
                bool "Enable UART3"
                default y

            config BSP_UART3_RX_USING_DMA
                bool "Enable UART3 RX DMA"
                depends on BSP_USING_UART3 && RT_SERIAL_USING_DMA
                default n
        endif
    
    menuconfig BSP_USING_ADC
        bool "Enable ADC"
        default n
        select RT_USING_ADC
        if BSP_USING_ADC
            config BSP_USING_ADC1
                bool "Enable ADC1"
                default n

        endif

    menuconfig BSP_USING_I2C
        bool "Enable using I2C BUS (software simulation)"
        default n
        select RT_USING_I2C
        select RT_USING_I2C_BITOPS
        select RT_USING_PIN
        if BSP_USING_I2C
            menuconfig BSP_USING_I2C1
                bool "Enable I2C1 BUS (software simulation)"
                default n
                if BSP_USING_I2C1
                    config BSP_I2C1_SCL_PIN
                        int "i2c1 scl pin number"
                        range 1 144
                        default 24
                    config BSP_I2C1_SDA_PIN
                        int "I2C1 sda pin number"
                        range 1 144
                        default 25
                endif
            menuconfig BSP_USING_I2C2
                bool "Enable I2C2 BUS (software simulation)"
                default n
                if BSP_USING_I2C2
                    config BSP_I2C2_SCL_PIN
                        int "i2c2 scl pin number"
                        range 1 144
                        default 10
                    config BSP_I2C2_SDA_PIN
                        int "I2C2 sda pin number"
                        range 1 144
                        default 11
                endif
        endif

    source "libraries/HAL_Drivers/Kconfig"
    
endmenu

menu "Board extended module Drivers"

endmenu
 
endmenu
```
